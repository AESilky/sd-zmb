; ==============
;
; CTC Library - BAUD rate generation and periodic interrupt.
;
; Copyright 2025-26 AESilky
; SPDX-License-Identifier: MIT License
;
; ==============
;

;;**************
;; @brief Initialize the module.
;; @ingroup ctc
;;
;; @entry
;;	E: Interrupt Vector base NNNNNxx0
;; @used
;;	ALL
;; @return
;;	Z: Success
;;	NZ: Failure
;;		A: Failure code
;;**************
		.global	ctc_minit

;;= Interrupt Vector Count - CTC has 4
IVCNT_CTC:	.equ	4


;;**************
;; @brief Interrupt Service Routine - NOP.
;; @ingroup ctc
;;
;; Only contains an RETI instruction. Used to fill in IVTable for the channels
;; that don't actually generate interrupts (but require a table entry).
;;
;; @entry
;;	NONE
;; @used
;;	NONE
;; @return
;;	RETI
;;
;;**************
		.global	ctc_isr_nop

;;**************
;; @brief Interrupt Service Routine - Periodic Interrupt.
;; @ingroup ctc
;;
;; Handles the periodic (60Hz) interrupt generated by CH3.
;;
;; @entry
;;	NONE
;; @used
;;	NONE (all saved)
;; @return
;;	RETI
;;
;;**************
		.global	ctc_isr_pi

